/**
 * Exact MSPM0C1106 DGS20 identity. The H1-R2.27 projection currently exposes
 * this domain identity but no per-pin map, so peripheral pins remain absent.
 */
//@cliArgs --device "MSPM0C1105_C1106" --package "VSSOP-20(DGS20)" --part "Default"
//@v2CliArgs --device "MSPM0C1106" --package "VSSOP-20(DGS20)"

const SYSCTL = scripting.addModule("/ti/driverlib/SYSCTL");
const ProjectConfig = scripting.addModule("/ti/project_config/ProjectConfig");
const Board = scripting.addModule("/ti/driverlib/Board", {}, false);

ProjectConfig.deviceSpin = "MSPM0C1106";
